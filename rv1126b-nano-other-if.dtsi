// SPDX-License-Identifier: (GPL-2.0+ OR MIT)
/*
 * Copyright (c) 2025 Guangzhou EASY EAI Technology Co., Ltd.
 */

&uart2 {
	status = "okay";
	pinctrl-names = "default";
	//pinctrl-0 = <&uart2m0_xfer_pins &uart2_485_pins>;
	pinctrl-0 = <&uart2m0_xfer_pins &uart2m0_rtsn_pins>;
	linux,rs485-enabled-at-boot-time;
	//rs485-rts-delay = <0x0 0>;
	rs485-rts-active-low;
	//rts-gpios = <&gpio3 RK_PA6 GPIO_ACTIVE_HIGH>;
};
